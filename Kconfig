## Kconfig
```kconfig
# SPDX-FileCopyrightText: 2026 roolrz
# SPDX-License-Identifier: Apache-2.0

config SYSTEM_APP_VM_RUNTIME
    bool "vm-runtime (/svc/vm-runtime)"
    default y
    depends on SYSTEM_APP_COMPONENT_MANAGER
    help
        Build and deploy hyper-vm-runtime at /svc/vm-runtime.
```
